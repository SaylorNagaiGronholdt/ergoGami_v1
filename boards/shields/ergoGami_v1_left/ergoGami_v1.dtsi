
/ {
    // Keyscan GPIO configuration
    kscan0: kscan {
        compatible = "zmk,kscan-gpio-matrix";
        diode-direction = "col2row";  // Set diode direction for the matrix
        wakeup-source;

        row-gpios = <
            &gpio1 6  (GPIO_ACTIVE_HIGH | GPIO_PULL_DOWN)
            &gpio1 15 (GPIO_ACTIVE_HIGH | GPIO_PULL_DOWN) 
            &gpio1 13 (GPIO_ACTIVE_HIGH | GPIO_PULL_DOWN) 
            &gpio1 11 (GPIO_ACTIVE_HIGH | GPIO_PULL_DOWN)  
        >;
    };
};